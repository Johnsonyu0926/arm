## zephyr/arch/common/Kconfig
```kconfig
config SEMIHOST
    bool "Semihosting support for ARM and RISC-V targets"
    depends on ARM || ARM64 || RISCV

config LEGACY_MULTI_LEVEL_TABLE_GENERATION
    bool "Auto generates the multi-level interrupt LUT (deprecated)"
    default y
    select DEPRECATED
    depends on MULTI_LEVEL_INTERRUPTS
    depends on !PLIC
    depends on !NXP_IRQSTEER
    depends on !RV32M1_INTMUX
    depends on !CAVS_ICTL
    depends on !DW_ICTL_ACE
    depends on !DW_ICTL

config ISR_TABLE_SHELL
    bool "Shell command to dump the ISR tables"
    depends on GEN_SW_ISR_TABLE
    depends on SHELL
// By GST @Date
```
